#include "oled.h"
#include "i2c.h"

#define OLED_ADDR    0x78

static void OLED_WR_CMD(uint8_t cmd)
{
    HAL_I2C_Mem_Write(&hi2c1, OLED_ADDR, 0x00, I2C_MEMADD_SIZE_8BIT, &cmd, 1, 100);
}

static void OLED_WR_DATA(uint8_t data)
{
    HAL_I2C_Mem_Write(&hi2c1, OLED_ADDR, 0x40, I2C_MEMADD_SIZE_8BIT, &data, 1, 100);
}

// 6x8 标准ASCII库（**绝对不会乱码**）
const uint8_t OLED_ASCII6x8[][6] = {
    {0x00,0x00,0x00,0x00,0x00,0x00}, //  
    {0x00,0x00,0x5F,0x00,0x00,0x00}, // !
    {0x00,0x07,0x00,0x07,0x00,0x00}, // "
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    {0x40,0x40,0x40,0x40,0x40,0x00}, // _
};

void OLED_Init(void)
{
    HAL_Delay(100);
    OLED_WR_CMD(0xAE); 
    OLED_WR_CMD(0xD5); OLED_WR_CMD(0x80);
    OLED_WR_CMD(0xA8); OLED_WR_CMD(0x3F);
    OLED_WR_CMD(0xD3); OLED_WR_CMD(0x00);
    OLED_WR_CMD(0x40); 
    OLED_WR_CMD(0x8D); OLED_WR_CMD(0x14);
    OLED_WR_CMD(0x20); OLED_WR_CMD(0x00); // 🔥水平地址模式（关键！）
    OLED_WR_CMD(0xA1); 
    OLED_WR_CMD(0xC8);
    OLED_WR_CMD(0xDA); OLED_WR_CMD(0x12);
    OLED_WR_CMD(0x81); OLED_WR_CMD(0xCF);
    OLED_WR_CMD(0xD9); OLED_WR_CMD(0xF1);
    OLED_WR_CMD(0xDB); OLED_WR_CMD(0x30);
    OLED_WR_CMD(0xA4);
    OLED_WR_CMD(0xA6);
    OLED_Clear();
    OLED_WR_CMD(0xAF);
    HAL_Delay(100);
}

void OLED_Clear(void)
{
    uint8_t y, x;
    for(y=0;y<8;y++){
        OLED_WR_CMD(0xB0+y);
        OLED_WR_CMD(0x00);
        OLED_WR_CMD(0x10);
        for(x=0;x<128;x++) OLED_WR_DATA(0x00);
    }
}

void OLED_ShowChar(uint8_t x, uint8_t y, uint8_t c)
{
    uint8_t i;
    c -= 32;
    OLED_WR_CMD(0xB0 + y);
    OLED_WR_CMD(0x00 + (x&0x0F));
    OLED_WR_CMD(0x10 + (x>>4));
    for(i=0;i<6;i++) OLED_WR_DATA(OLED_ASCII6x8[c][i]);
}

void OLED_ShowStr(uint8_t x, uint8_t y, char *str)
{
    while(*str)
    {
        OLED_ShowChar(x,y,*str);
        x += 6;
        if(x>122) {x=0;y++;}
        str++;
    }
}

